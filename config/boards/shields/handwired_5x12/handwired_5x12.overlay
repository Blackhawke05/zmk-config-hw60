/ {
    chosen {
        zmk,kscan = &kscan0;
    };

    kscan0: kscan_0 {
        compatible = "zmk,kscan-gpio-matrix";
        label = "KSCAN";
        diode-direction = "col2row";

        col-gpios
            = <&gpio0 24 GPIO_ACTIVE_HIGH>  // Col 1
            , <&gpio1 0  GPIO_ACTIVE_HIGH>  // Col 2
            , <&gpio0 11 GPIO_ACTIVE_HIGH>  // Col 3
            , <&gpio1 4  GPIO_ACTIVE_HIGH>  // Col 4
            , <&gpio1 6  GPIO_ACTIVE_HIGH>  // Col 5
            , <&gpio0 31 GPIO_ACTIVE_HIGH>  // Col 6
            , <&gpio0 29 GPIO_ACTIVE_HIGH>  // Col 7
            , <&gpio0 2  GPIO_ACTIVE_HIGH>  // Col 8
            , <&gpio1 15 GPIO_ACTIVE_HIGH>  // Col 9
            , <&gpio1 13 GPIO_ACTIVE_HIGH>  // Col 10
            , <&gpio1 11 GPIO_ACTIVE_HIGH>  // Col 11
            , <&gpio0 10 GPIO_ACTIVE_HIGH>  // Col 12
            ;

        row-gpios
            = <&gpio0 6  (GPIO_ACTIVE_HIGH | GPIO_PULL_DOWN)>  // Row 1
            , <&gpio0 8  (GPIO_ACTIVE_HIGH | GPIO_PULL_DOWN)>  // Row 2
            , <&gpio0 17 (GPIO_ACTIVE_HIGH | GPIO_PULL_DOWN)>  // Row 3
            , <&gpio0 20 (GPIO_ACTIVE_HIGH | GPIO_PULL_DOWN)>  // Row 4
            , <&gpio0 22 (GPIO_ACTIVE_HIGH | GPIO_PULL_DOWN)>  // Row 5
            ;
    };
};